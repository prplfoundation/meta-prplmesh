## conf/layer.conf
```bitbake
# SPDX-License-Identifier: BSD-2-Clause-Patent
# SPDX-FileCopyrightText: 2020 the prplMesh contributors (see AUTHORS.md)
# This code is subject to the terms of the BSD+Patent license.
# See LICENSE file for more details.

# We have a conf and classes directory, add to BBPATH
BBPATH .= ":${LAYERDIR}"

# We have recipes-* directories, add to BBFILES
BBFILES += "${LAYERDIR}/recipes-*/*/*.bb \
            ${LAYERDIR}/recipes-*/*/*.bbappend"

BBFILE_COLLECTIONS += "prplmesh"
BBFILE_PATTERN_prplmesh = "^${LAYERDIR}/"
BBFILE_PRIORITY_prplmesh = "9"

LICENSE_PATH += "${LAYERDIR}/LICENSES"

BB_DANGLINGAPPENDS_WARNONLY = "1"
```
